## zh-tw/6/kbuild/kconfig.html
```kconfig
<!DOCTYPE html>

<html lang="zh-TW" data-content_root="../">
  <head>
    <meta charset="utf-8" />
    <meta name="viewport" content="width=device-width, initial-scale=1.0" /><meta name="viewport" content="width=device-width, initial-scale=1" />

    <title>Configuration targets and editors &#8212; The Linux Kernel unknown version 說明文件</title>
    <link rel="stylesheet" type="text/css" href="../_static/pygments.css?v=03e43079" />
    <link rel="stylesheet" type="text/css" href="../_static/basic.css?v=b08954a9" />
    <link rel="stylesheet" type="text/css" href="../_static/alabaster.css?v=adfc0c0d" />
    <script src="../_static/documentation_options.js?v=b446b479"></script>
    <script src="../_static/doctools.js?v=9bcbadda"></script>
    <script src="../_static/sphinx_highlight.js?v=dc90522c"></script>
    <script src="../_static/translations.js?v=cbf116e0"></script>
    <link rel="canonical" href="https://projects.localizethedocs.org/linux-docs-l10n/kbuild/kconfig.html" />
    <link rel="index" title="索引" href="../genindex.html" />
    <link rel="search" title="搜尋" href="../search.html" />
    <link rel="next" title="Linux Kernel Makefiles" href="makefiles.html" />
    <link rel="prev" title="Kbuild" href="kbuild.html" />

   
  <link rel="stylesheet" href="../_static/custom.css" type="text/css" />
  

  
  

<script type="text/javascript" src="../ltd-provenance.js"></script>
<script type="text/javascript" src="../ltd-current.js"></script>
<script type="text/javascript" src="../../../ltd-config.js"></script>
<script type="text/javascript" src="../../../ltd-flyout.js"></script>

  </head><body>
  <div class="document">
    
      <div class="sphinxsidebar" role="navigation" aria-label="Main">
        <div class="sphinxsidebarwrapper">
            <p class="logo"><a href="../index.html">
              <img class="logo" src="../_static/logo.svg" alt="Logo of The Linux Kernel"/>
            </a></p>
<h1 class="logo"><a href="../index.html">The Linux Kernel</a></h1>



<p class="blurb">6.19.0</p>







<search id="searchbox" style="display: none" role="search">
  <h3 id="searchlabel">快速搜尋</h3>
    <div class="searchformwrapper">
    <form class="search" action="../search.html" method="get">
      <input type="text" name="q" aria-labelledby="searchlabel" autocomplete="off" autocorrect="off" autocapitalize="off" spellcheck="false"/>
      <input type="submit" value="前往" />
    </form>
    </div>
</search>
<script>document.getElementById('searchbox').style.display = "block"</script>


<p>
<h3 class="kernel-toc-contents">Contents</h3>
<input type="checkbox" class="kernel-toc-toggle" id = "kernel-toc-toggle" checked>
<label class="kernel-toc-title" for="kernel-toc-toggle"></label>

<div class="kerneltoc" id="kerneltoc">
<ul>
<li class="toctree-l1"><a class="reference internal" href="../process/development-process.html">Development process</a></li>
<li class="toctree-l1"><a class="reference internal" href="../process/submitting-patches.html">提交補釘</a></li>
<li class="toctree-l1"><a class="reference internal" href="../process/code-of-conduct.html">行為守則</a></li>
<li class="toctree-l1"><a class="reference internal" href="../maintainer/index.html">維護者手冊</a></li>
<li class="toctree-l1"><a class="reference internal" href="../process/index.html">All development-process docs</a></li>
</ul>
<ul>
<li class="toctree-l1"><a class="reference internal" href="../core-api/index.html">核心 API</a></li>
<li class="toctree-l1"><a class="reference internal" href="../driver-api/index.html">Driver APIs</a></li>
<li class="toctree-l1"><a class="reference internal" href="../subsystem-apis.html">子系統</a></li>
<li class="toctree-l1"><a class="reference internal" href="../locking/index.html">Locking</a></li>
</ul>
<ul>
<li class="toctree-l1"><a class="reference internal" href="../process/license-rules.html">Licensing rules</a></li>
<li class="toctree-l1"><a class="reference internal" href="../doc-guide/index.html">撰寫文件</a></li>
<li class="toctree-l1"><a class="reference internal" href="../dev-tools/index.html">開發工具</a></li>
<li class="toctree-l1"><a class="reference internal" href="../dev-tools/testing-overview.html">測試指南</a></li>
<li class="toctree-l1"><a class="reference internal" href="../kernel-hacking/index.html">Hacking guide</a></li>
<li class="toctree-l1"><a class="reference internal" href="../trace/index.html">Tracing</a></li>
<li class="toctree-l1"><a class="reference internal" href="../fault-injection/index.html">Fault injection</a></li>
<li class="toctree-l1"><a class="reference internal" href="../livepatch/index.html">即時補釘</a></li>
<li class="toctree-l1"><a class="reference internal" href="../rust/index.html">Rust</a></li>
</ul>
<ul class="current">
<li class="toctree-l1"><a class="reference internal" href="../admin-guide/index.html">Administration</a></li>
<li class="toctree-l1 current"><a class="reference internal" href="index.html">建置系統</a><ul class="current">
<li class="toctree-l2"><a class="reference internal" href="kconfig-language.html">Kconfig Language</a></li>
<li class="toctree-l2"><a class="reference internal" href="kconfig-macro-language.html">Kconfig macro language</a></li>
<li class="toctree-l2"><a class="reference internal" href="kbuild.html">Kbuild</a></li>
<li class="toctree-l2 current"><a class="current reference internal" href="#">Configuration targets and editors</a><ul>
<li class="toctree-l3"><a class="reference internal" href="#general">General</a></li>
<li class="toctree-l3"><a class="reference internal" href="#environment-variables">Environment variables</a></li>
<li class="toctree-l3"><a class="reference internal" href="#menuconfig">menuconfig</a></li>
<li class="toctree-l3"><a class="reference internal" href="#nconfig">nconfig</a></li>
<li class="toctree-l3"><a class="reference internal" href="#xconfig">xconfig</a></li>
<li class="toctree-l3"><a class="reference internal" href="#gconfig">gconfig</a></li>
</ul>
</li>
<li class="toctree-l2"><a class="reference internal" href="makefiles.html">Linux Kernel Makefiles</a></li>
<li class="toctree-l2"><a class="reference internal" href="modules.html">Building External Modules</a></li>
<li class="toctree-l2"><a class="reference internal" href="headers_install.html">Exporting kernel headers for use by userspace</a></li>
<li class="toctree-l2"><a class="reference internal" href="issues.html">Recursion issues</a></li>
<li class="toctree-l2"><a class="reference internal" href="reproducible-builds.html">Reproducible builds</a></li>
<li class="toctree-l2"><a class="reference internal" href="gcc-plugins.html">GCC plugin infrastructure</a></li>
<li class="toctree-l2"><a class="reference internal" href="llvm.html">使用 Clang/LLVM 建置 Linux</a></li>
<li class="toctree-l2"><a class="reference internal" href="gendwarfksyms.html">DWARF module versioning</a></li>
<li class="toctree-l2"><a class="reference internal" href="bash-completion.html">Bash completion for Kbuild</a></li>
</ul>
</li>
<li class="toctree-l1"><a class="reference internal" href="../admin-guide/reporting-issues.html">回報議題</a></li>
<li class="toctree-l1"><a class="reference internal" href="../tools/index.html">使用者空間工具</a></li>
<li class="toctree-l1"><a class="reference internal" href="../userspace-api/index.html">使用者空間 API</a></li>
</ul>
<ul>
<li class="toctree-l1"><a class="reference internal" href="../firmware-guide/index.html">韌體</a></li>
<li class="toctree-l1"><a class="reference internal" href="../devicetree/index.html">韌體與裝置樹</a></li>
</ul>
<ul>
<li class="toctree-l1"><a class="reference internal" href="../arch/index.html">CPU 架構</a></li>
</ul>
<ul>
<li class="toctree-l1"><a class="reference internal" href="../staging/index.html">未排序的文件</a></li>
</ul>

</div>

<script type="text/javascript"> <!--
  var sbar = document.getElementsByClassName("sphinxsidebar")[0];
  let currents = document.getElementsByClassName("current")
  if (currents.length) {
    sbar.scrollTop = currents[currents.length - 1].offsetTop;
  }
  --> </script>
  <div role="note" aria-label="source link">
    <h3>本頁</h3>
    <ul class="this-page-menu">
      <li><a href="../_sources/kbuild/kconfig.rst.txt"
            rel="nofollow">顯示原始碼</a></li>
    </ul>
   </div>
        </div>
      </div>
      <div class="documentwrapper">
        <div class="bodywrapper">
          

          <div class="body" role="main">
            
  <section id="configuration-targets-and-editors">
<h1>Configuration targets and editors<a class="headerlink" href="#configuration-targets-and-editors" title="連結到這個標頭">¶</a></h1>
<p>This file contains some assistance for using <code class="docutils literal notranslate"><span class="pre">make</span> <span class="pre">*config</span></code>.</p>
<p>Use <code class="docutils literal notranslate"><span class="pre">make</span> <span class="pre">help</span></code> to list all of the possible configuration targets.</p>
<p>The xconfig ('qconf'), menuconfig ('mconf'), and nconfig ('nconf')
programs also have embedded help text.  Be sure to check that for
navigation, search, and other general help text.</p>
<p>The gconfig ('gconf') program has limited help text.</p>
<section id="general">
<h2>General<a class="headerlink" href="#general" title="連結到這個標頭">¶</a></h2>
<p>New kernel releases often introduce new config symbols.  Often more
important, new kernel releases may rename config symbols.  When
this happens, using a previously working .config file and running
&quot;make oldconfig&quot; won't necessarily produce a working new kernel
for you, so you may find that you need to see what NEW kernel
symbols have been introduced.</p>
<p>To see a list of new config symbols, use:</p>
<div class="highlight-none notranslate"><div class="highlight"><pre><span></span>cp user/some/old.config .config
make listnewconfig
</pre></div>
</div>
<p>and the config program will list any new symbols, one per line.</p>
<p>Alternatively, you can use the brute force method:</p>
<div class="highlight-none notranslate"><div class="highlight"><pre><span></span>make oldconfig
scripts/diffconfig .config.old .config | less
</pre></div>
</div>
</section>
<section id="environment-variables">
<h2>Environment variables<a class="headerlink" href="#environment-variables" title="連結到這個標頭">¶</a></h2>
<p>Environment variables for <code class="docutils literal notranslate"><span class="pre">*config</span></code>:</p>
<dl class="simple">
<dt><code class="docutils literal notranslate"><span class="pre">KCONFIG_CONFIG</span></code></dt><dd><p>This environment variable can be used to specify a default kernel config
file name to override the default name of &quot;.config&quot;.</p>
</dd>
<dt><code class="docutils literal notranslate"><span class="pre">KCONFIG_DEFCONFIG_LIST</span></code></dt><dd><p>This environment variable specifies a list of config files which can be
used as a base configuration in case the .config does not exist yet.
Entries in the list are separated with whitespaces to each other, and
the first one that exists is used.</p>
</dd>
<dt><code class="docutils literal notranslate"><span class="pre">KCONFIG_OVERWRITECONFIG</span></code></dt><dd><p>If you set KCONFIG_OVERWRITECONFIG in the environment, Kconfig will not
break symlinks when .config is a symlink to somewhere else.</p>
</dd>
<dt><code class="docutils literal notranslate"><span class="pre">KCONFIG_WARN_UNKNOWN_SYMBOLS</span></code></dt><dd><p>This environment variable makes Kconfig warn about all unrecognized
symbols in the config input.</p>
</dd>
<dt><code class="docutils literal notranslate"><span class="pre">KCONFIG_WERROR</span></code></dt><dd><p>If set, Kconfig treats warnings as errors.</p>
</dd>
<dt><code class="docutils literal notranslate"><span class="pre">CONFIG_</span></code></dt><dd><p>If you set <code class="docutils literal notranslate"><span class="pre">CONFIG_</span></code> in the environment, Kconfig will prefix all symbols
with its value when saving the configuration, instead of using the
default, <code class="docutils literal notranslate"><span class="pre">CONFIG_</span></code>.</p>
</dd>
</dl>
<p>Environment variables for <code class="docutils literal notranslate"><span class="pre">{allyes/allmod/allno/alldef/rand}config</span></code>:</p>
<dl>
<dt><code class="docutils literal notranslate"><span class="pre">KCONFIG_ALLCONFIG</span></code></dt><dd><p>The allyesconfig/allmodconfig/alldefconfig/allnoconfig/randconfig variants
can also use the environment variable KCONFIG_ALLCONFIG as a flag or a
filename that contains config symbols that the user requires to be set to a
specific value.  If KCONFIG_ALLCONFIG is used without a filename where
KCONFIG_ALLCONFIG == &quot;&quot; or KCONFIG_ALLCONFIG == &quot;1&quot;, <code class="docutils literal notranslate"><span class="pre">make</span> <span class="pre">*config</span></code>
checks for a file named &quot;all{yes/mod/no/def/random}.config&quot;
(corresponding to the <code class="docutils literal notranslate"><span class="pre">*config</span></code> command that was used) for symbol values
that are to be forced.  If this file is not found, it checks for a
file named &quot;all.config&quot; to contain forced values.</p>
<p>This enables you to create &quot;miniature&quot; config (miniconfig) or custom
config files containing just the config symbols that you are interested
in.  Then the kernel config system generates the full .config file,
including symbols of your miniconfig file.</p>
<p>This <code class="docutils literal notranslate"><span class="pre">KCONFIG_ALLCONFIG</span></code> file is a config file which contains
(usually a subset of all) preset config symbols.  These variable
settings are still subject to normal dependency checks.</p>
<p>Examples:</p>
<div class="highlight-none notranslate"><div class="highlight"><pre><span></span>KCONFIG_ALLCONFIG=custom-notebook.config make allnoconfig
</pre></div>
</div>
<p>or:</p>
<div class="highlight-none notranslate"><div class="highlight"><pre><span></span>KCONFIG_ALLCONFIG=mini.config make allnoconfig
</pre></div>
</div>
<p>or:</p>
<div class="highlight-none notranslate"><div class="highlight"><pre><span></span>make KCONFIG_ALLCONFIG=mini.config allnoconfig
</pre></div>
</div>
<p>These examples will disable most options (allnoconfig) but enable or
disable the options that are explicitly listed in the specified
mini-config files.</p>
</dd>
</dl>
<p>Environment variables for <code class="docutils literal notranslate"><span class="pre">randconfig</span></code>:</p>
<dl>
<dt><code class="docutils literal notranslate"><span class="pre">KCONFIG_SEED</span></code></dt><dd><p>You can set this to the integer value used to seed the RNG, if you want
to somehow debug the behaviour of the kconfig parser/frontends.
If not set, the current time will be used.</p>
</dd>
<dt><code class="docutils literal notranslate"><span class="pre">KCONFIG_PROBABILITY</span></code></dt><dd><p>This variable can be used to skew the probabilities. This variable can
be unset or empty, or set to three different formats:</p>
<table class="docutils align-default">
<thead>
<tr class="row-odd"><th class="head"><p>KCONFIG_PROBABILITY</p></th>
<th class="head"><p>y:n split</p></th>
<th class="head"><p>y:m:n split</p></th>
</tr>
</thead>
<tbody>
<tr class="row-even"><td><p>unset or empty</p></td>
<td><p>50  : 50</p></td>
<td><p>33  : 33  : 34</p></td>
</tr>
<tr class="row-odd"><td><p>N</p></td>
<td><p>N  : 100-N</p></td>
<td><p>N/2 : N/2 : 100-N</p></td>
</tr>
<tr class="row-even"><td><p>[1] N:M</p></td>
<td><p>N+M : 100-(N+M)</p></td>
<td><p>N  :  M  : 100-(N+M)</p></td>
</tr>
<tr class="row-odd"><td><p>[2] N:M:L</p></td>
<td><p>N  : 100-N</p></td>
<td><p>M  :  L  : 100-(M+L)</p></td>
</tr>
</tbody>
</table>
</dd>
</dl>
<p>where N, M and L are integers (in base 10) in the range [0,100], and so
that:</p>
<blockquote>
<div><p>[1] N+M is in the range [0,100]</p>
<p>[2] M+L is in the range [0,100]</p>
</div></blockquote>
<p>Examples:</p>
<div class="highlight-none notranslate"><div class="highlight"><pre><span></span>KCONFIG_PROBABILITY=10
    10% of booleans will be set to &#39;y&#39;, 90% to &#39;n&#39;
    5% of tristates will be set to &#39;y&#39;, 5% to &#39;m&#39;, 90% to &#39;n&#39;
KCONFIG_PROBABILITY=15:25
    40% of booleans will be set to &#39;y&#39;, 60% to &#39;n&#39;
    15% of tristates will be set to &#39;y&#39;, 25% to &#39;m&#39;, 60% to &#39;n&#39;
KCONFIG_PROBABILITY=10:15:15
    10% of booleans will be set to &#39;y&#39;, 90% to &#39;n&#39;
    15% of tristates will be set to &#39;y&#39;, 15% to &#39;m&#39;, 70% to &#39;n&#39;
</pre></div>
</div>
<p>Environment variables for <code class="docutils literal notranslate"><span class="pre">syncconfig</span></code>:</p>
<dl class="simple">
<dt><code class="docutils literal notranslate"><span class="pre">KCONFIG_NOSILENTUPDATE</span></code></dt><dd><p>If this variable has a non-blank value, it prevents silent kernel
config updates (requires explicit updates).</p>
</dd>
<dt><code class="docutils literal notranslate"><span class="pre">KCONFIG_AUTOCONFIG</span></code></dt><dd><p>This environment variable can be set to specify the path &amp; name of the
&quot;auto.conf&quot; file.  Its default value is &quot;include/config/auto.conf&quot;.</p>
</dd>
<dt><code class="docutils literal notranslate"><span class="pre">KCONFIG_AUTOHEADER</span></code></dt><dd><p>This environment variable can be set to specify the path &amp; name of the
&quot;autoconf.h&quot; (header) file.
Its default value is &quot;include/generated/autoconf.h&quot;.</p>
</dd>
</dl>
</section>
<section id="menuconfig">
<h2>menuconfig<a class="headerlink" href="#menuconfig" title="連結到這個標頭">¶</a></h2>
<p>Searching in menuconfig:</p>
<blockquote>
<div><p>The Search function searches for kernel configuration symbol
names, so you have to know something close to what you are
looking for.</p>
<p>Example:</p>
<div class="highlight-none notranslate"><div class="highlight"><pre><span></span>/hotplug
This lists all config symbols that contain &quot;hotplug&quot;,
e.g., HOTPLUG_CPU, MEMORY_HOTPLUG.
</pre></div>
</div>
<p>For search help, enter / followed by TAB-TAB (to highlight
&lt;Help&gt;) and Enter.  This will tell you that you can also use
regular expressions (regexes) in the search string, so if you
are not interested in MEMORY_HOTPLUG, you could try:</p>
<div class="highlight-none notranslate"><div class="highlight"><pre><span></span>/^hotplug
</pre></div>
</div>
<p>When searching, symbols are sorted thus:</p>
<ul class="simple">
<li><p>first, exact matches, sorted alphabetically (an exact match
is when the search matches the complete symbol name);</p></li>
<li><p>then, other matches, sorted alphabetically.</p></li>
</ul>
<p>For example, ^ATH.K matches:</p>
<blockquote>
<div><p>ATH5K ATH9K ATH5K_AHB ATH5K_DEBUG [...] ATH6KL ATH6KL_DEBUG
[...] ATH9K_AHB ATH9K_BTCOEX_SUPPORT ATH9K_COMMON [...]</p>
</div></blockquote>
<p>of which only ATH5K and ATH9K match exactly and so are sorted
first (and in alphabetical order), then come all other symbols,
sorted in alphabetical order.</p>
<p>In this menu, pressing the key in the (#) prefix will jump
directly to that location. You will be returned to the current
search results after exiting this new menu.</p>
</div></blockquote>
<p>User interface options for 'menuconfig':</p>
<dl>
<dt><code class="docutils literal notranslate"><span class="pre">MENUCONFIG_COLOR</span></code></dt><dd><p>It is possible to select different color themes using the variable
MENUCONFIG_COLOR.  To select a theme use:</p>
<div class="highlight-none notranslate"><div class="highlight"><pre><span></span>make MENUCONFIG_COLOR=&lt;theme&gt; menuconfig
</pre></div>
</div>
<p>Available themes are:</p>
<div class="highlight-none notranslate"><div class="highlight"><pre><span></span>- mono       =&gt; selects colors suitable for monochrome displays
- blackbg    =&gt; selects a color scheme with black background
- classic    =&gt; theme with blue background. The classic look
- bluetitle  =&gt; a LCD friendly version of classic. (default)
</pre></div>
</div>
</dd>
<dt><code class="docutils literal notranslate"><span class="pre">MENUCONFIG_MODE</span></code></dt><dd><p>This mode shows all sub-menus in one large tree.</p>
<p>Example:</p>
<div class="highlight-none notranslate"><div class="highlight"><pre><span></span>make MENUCONFIG_MODE=single_menu menuconfig
</pre></div>
</div>
</dd>
</dl>
</section>
<section id="nconfig">
<h2>nconfig<a class="headerlink" href="#nconfig" title="連結到這個標頭">¶</a></h2>
<p>nconfig is an alternate text-based configurator.  It lists function
keys across the bottom of the terminal (window) that execute commands.
You can also just use the corresponding numeric key to execute the
commands unless you are in a data entry window.  E.g., instead of F6
for Save, you can just press 6.</p>
<p>Use F1 for Global help or F3 for the Short help menu.</p>
<p>Searching in nconfig:</p>
<blockquote>
<div><p>You can search either in the menu entry &quot;prompt&quot; strings
or in the configuration symbols.</p>
<p>Use / to begin a search through the menu entries.  This does
not support regular expressions.  Use &lt;Down&gt; or &lt;Up&gt; for
Next hit and Previous hit, respectively.  Use &lt;Esc&gt; to
terminate the search mode.</p>
<p>F8 (SymSearch) searches the configuration symbols for the
given string or regular expression (regex).</p>
<p>In the SymSearch, pressing the key in the (#) prefix will
jump directly to that location. You will be returned to the
current search results after exiting this new menu.</p>
</div></blockquote>
<p>Environment variables:</p>
<dl>
<dt><code class="docutils literal notranslate"><span class="pre">NCONFIG_MODE</span></code></dt><dd><p>This mode shows all sub-menus in one large tree.</p>
<p>Example:</p>
<div class="highlight-none notranslate"><div class="highlight"><pre><span></span>make NCONFIG_MODE=single_menu nconfig
</pre></div>
</div>
</dd>
</dl>
</section>
<section id="xconfig">
<h2>xconfig<a class="headerlink" href="#xconfig" title="連結到這個標頭">¶</a></h2>
<p>Searching in xconfig:</p>
<blockquote>
<div><p>The Search function searches for kernel configuration symbol
names, so you have to know something close to what you are
looking for.</p>
<p>Example:</p>
<div class="highlight-none notranslate"><div class="highlight"><pre><span></span>Ctrl-F hotplug
</pre></div>
</div>
<p>or:</p>
<div class="highlight-none notranslate"><div class="highlight"><pre><span></span>Menu: File, Search, hotplug
</pre></div>
</div>
<p>lists all config symbol entries that contain &quot;hotplug&quot; in
the symbol name.  In this Search dialog, you may change the
config setting for any of the entries that are not grayed out.
You can also enter a different search string without having
to return to the main menu.</p>
</div></blockquote>
</section>
<section id="gconfig">
<h2>gconfig<a class="headerlink" href="#gconfig" title="連結到這個標頭">¶</a></h2>
<p>Searching in gconfig:</p>
<blockquote>
<div><p>There is no search command in gconfig.  However, gconfig does
have several different viewing choices, modes, and options.</p>
</div></blockquote>
</section>
</section>


          </div>
          
        </div>
      </div>
    <div class="clearer"></div>
  </div>
    <div class="footer">
      &#169;The kernel development community.
      
      |
      Powered by <a href="https://www.sphinx-doc.org/">Sphinx 8.2.3</a>
      &amp; <a href="https://alabaster.readthedocs.io">Alabaster 1.0.0</a>
      
      |
      <a href="../_sources/kbuild/kconfig.rst.txt"
          rel="nofollow">Page source</a>
    </div>

    

    
  </body>
</html>
```
